## build/Kconfig/Kconfig.shield
```kconfig
osource "c:/ncs/v2.5.0/zephyr/samples/basic/blinky_pwm/boards/shields/*/Kconfig.shield"
osource "C:/ncs/v2.5.0/nrf/boards/shields/*/Kconfig.shield"
```

## build/Kconfig/Kconfig.shield.defconfig
```kconfig
osource "c:/ncs/v2.5.0/zephyr/samples/basic/blinky_pwm/boards/shields/*/Kconfig.defconfig"
osource "C:/ncs/v2.5.0/nrf/boards/shields/*/Kconfig.defconfig"
```
